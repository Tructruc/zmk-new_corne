## Kconfig
```kconfig
# Beopylar status screen (see src/status_screen.c).
#
# Loaded as a Zephyr module from this config repo: zephyr/module.yml points both
# `cmake` and `kconfig` here, so the sources are only compiled when this symbol
# is enabled.

config BEOPYLAR_HOST_NAMES
	bool "Read the paired host's Bluetooth name"
	default y
	depends on BEOPYLAR_DISPLAY
	depends on BT_CONN
	depends on !ZMK_SPLIT || ZMK_SPLIT_ROLE_CENTRAL
	select BT_GATT_CLIENT
	help
	  Ask the host for its Generic Access device name (0x2A00) shortly after
	  it connects, and keep it per Bluetooth profile so the link page can show
	  "macbook" instead of "B2".  Read only, best effort, and cosmetic: a host
	  that refuses leaves the slot number in place.  Only the central half ever
	  connects to a host, so this is central only.

config BEOPYLAR_DISPLAY
	bool "Beopylar custom status screen for the nice!view panels"
	depends on ZMK_DISPLAY
	select LV_USE_CANVAS
	select LV_FONT_MONTSERRAT_12
	select LV_FONT_MONTSERRAT_14
	select LV_FONT_MONTSERRAT_16
	select LV_FONT_MONTSERRAT_28
	select LV_FONT_UNSCII_8
	help
	  Replaces the stock nice!view widgets with a single hand-drawn screen
	  that is designed in portrait (the panel is mounted vertically on the
	  eyelash_corne) and rotated into the 160x68 panel buffer at paint time.

	  Central half: a status page (battery + charging bolt, active layer,
	  output/profile, the four modifiers as chips, the other half's battery
	  when it is in touch) and a link page (BLE profiles with bonded/connected
	  state, output, peer battery/age).  A third screen takes over while a BLE
	  profile is open for pairing.
	  Peripheral half: its own battery + charging bolt, the layer and output
	  the central relays over the split link, and the link state.

	  Requires the shield to select the custom status screen (nice_view
	  does, via Kconfig.defconfig) and CONFIG_NICE_VIEW_WIDGET_STATUS=n so
	  the shield's own custom_status_screen.c does not define
	  zmk_display_status_screen() as well.
```

## dts/bindings/behaviors/beopylar,behavior-display-page.yaml
```yaml
# Copyright (c) 2024 The ZMK Contributors
# SPDX-License-Identifier: MIT

description: |
  Move the Beopylar status screen to another page.

  One parameter: 1 for the next page, -1 for the previous one. Bound on the FN
  layer in config/eyelash_corne.keymap through a sensor-rotate wrapper, so
  twisting the encoder walks the pages; the screen itself is implemented in
  src/status_screen.c.

compatible: "beopylar,behavior-display-page"

include: one_param.yaml
```
